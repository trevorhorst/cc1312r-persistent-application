/**
 * @cliArgs --board "/ti/boards/CC1312R1_LAUNCHXL" --device "CC1312R1F3RGZ" --part "Default" --package "RGZ" --rtos "tirtos7" --product "simplelink_cc13xx_cc26xx_sdk@8.32.00.07"
 * @versions {"tool":"1.21.1+3772"}
 */

/**
 * Import the modules used in this configuration.
 */
const CCFG        = scripting.addModule("/ti/devices/CCFG");
const custom      = scripting.addModule("/ti/devices/radioconfig/custom");
const rfdesign    = scripting.addModule("/ti/devices/radioconfig/rfdesign");
const GPIO        = scripting.addModule("/ti/drivers/GPIO");
const GPIO1       = GPIO.addInstance();
const GPIO2       = GPIO.addInstance();
const GPIO3       = GPIO.addInstance();
const GPIO4       = GPIO.addInstance();
const NVS         = scripting.addModule("/ti/drivers/NVS");
const NVS1        = NVS.addInstance();
const NVS2        = NVS.addInstance();
const NVS3        = NVS.addInstance();
const RF          = scripting.addModule("/ti/drivers/RF");
const Timer       = scripting.addModule("/ti/drivers/Timer", {}, false);
const Timer1      = Timer.addInstance();
const UART2       = scripting.addModule("/ti/drivers/UART2", {}, false);
const UART21      = UART2.addInstance();
const Settings    = scripting.addModule("/ti/posix/tirtos/Settings");
const BIOS        = scripting.addModule("/ti/sysbios/BIOS");
const Event       = scripting.addModule("/ti/sysbios/knl/Event");
const Idle        = scripting.addModule("/ti/sysbios/knl/Idle", {}, false);
const Idle2       = Idle.addInstance();
const Mailbox     = scripting.addModule("/ti/sysbios/knl/Mailbox");
const Error       = scripting.addModule("/ti/sysbios/runtime/Error");
const SysCallback = scripting.addModule("/ti/sysbios/runtime/SysCallback");
const Timestamp   = scripting.addModule("/ti/sysbios/runtime/Timestamp");

/**
 * Write custom configuration values to the imported modules.
 */
CCFG.enableCodeGeneration = false;

custom.prop8                                              = ["custom868"];
custom.radioConfigcustom868.phyType868                    = "2gfsk50kbps";
custom.radioConfigcustom868.carrierFrequency              = 868.0000;
custom.radioConfigcustom868.txPower                       = "10";
custom.radioConfigcustom868.$name                         = "RF_Custom_Setting";
custom.radioConfigcustom868.codeExportConfig.$name        = "ti_devices_radioconfig_code_export_param0";
custom.radioConfigcustom868.codeExportConfig.symGenMethod = "Legacy";

GPIO1.$hardware = system.deviceData.board.components.LED_GREEN;
GPIO1.$name     = "CONFIG_GPIO_GLED";

GPIO2.$hardware = system.deviceData.board.components.LED_RED;
GPIO2.$name     = "CONFIG_GPIO_RLED";

GPIO3.$hardware        = system.deviceData.board.components["BTN-1"];
GPIO3.$name            = "CONFIG_GPIO_BTN1";
GPIO3.pull             = "Pull Up";
GPIO3.interruptTrigger = "Falling Edge";

GPIO4.$hardware        = system.deviceData.board.components["BTN-2"];
GPIO4.$name            = "CONFIG_GPIO_BTN2";
GPIO4.pull             = "Pull Up";
GPIO4.interruptTrigger = "Falling Edge";

NVS1.$name                    = "CONFIG_NVS_UAPP";
NVS1.internalFlash.$name      = "ti_drivers_nvs_NVSCC26XX1";
NVS1.internalFlash.regionType = "Pointer";
NVS1.internalFlash.regionSize = 0x40000;

NVS2.$name                    = "CONFIG_NVS_ENV";
NVS2.internalFlash.$name      = "ti_drivers_nvs_NVSCC26XX2";
NVS2.internalFlash.regionBase = 0x42000;

NVS3.$name                    = "CONFIG_NVS_PAPP";
NVS3.internalFlash.$name      = "ti_drivers_nvs_NVSCC26XX0";
NVS3.internalFlash.regionBase = 0x44000;
NVS3.internalFlash.regionSize = 0x12000;
NVS3.internalFlash.regionType = "Pointer";

Timer1.$name               = "CONFIG_TIMER_0";
Timer1.timerInstance.$name = "CONFIG_GPTIMER_0";

UART21.$name     = "CONFIG_UART2_0";
UART21.$hardware = system.deviceData.board.components.XDS110UART;

BIOS.assertsEnabled = false;
BIOS.heapBaseAddr   = "__primary_heap_start__";
BIOS.heapEndAddr    = "__primary_heap_end__";

const Clock      = scripting.addModule("/ti/sysbios/knl/Clock", {}, false);
Clock.tickPeriod = 10;

const Timer_1 = scripting.addModule("/ti/sysbios/family/arm/cc26xx/Timer", {}, false);

Idle2.$name   = "powerIdle";
Idle2.idleFxn = "Power_idleFunc";

const Semaphore            = scripting.addModule("/ti/sysbios/knl/Semaphore", {}, false);
Semaphore.supportsPriority = false;

const Swi         = scripting.addModule("/ti/sysbios/knl/Swi", {}, false);
Swi.numPriorities = 6;

const Task             = scripting.addModule("/ti/sysbios/knl/Task", {}, false);
Task.checkStackFlag    = false;
Task.defaultStackSize  = 512;
Task.idleTaskStackSize = 512;
Task.numPriorities     = 6;

Error.policy       = "Error_SPIN";
Error.printDetails = false;

const System           = scripting.addModule("/ti/sysbios/runtime/System", {}, false);
System.abortFxn        = "System_abortSpin";
System.exitFxn         = "System_exitSpin";
System.extendedFormats = "%f";
System.supportModule   = "SysCallback";

/**
 * Pinmux solution for unlocked pins/peripherals. This ensures that minor changes to the automatic solver in a future
 * version of the tool will not impact the pinmux you originally saw.  These lines can be completely deleted in order to
 * re-solve from scratch.
 */
GPIO1.gpioPin.$suggestSolution              = "boosterpack.40";
GPIO2.gpioPin.$suggestSolution              = "boosterpack.39";
GPIO3.gpioPin.$suggestSolution              = "boosterpack.13";
GPIO4.gpioPin.$suggestSolution              = "boosterpack.12";
Timer1.timerInstance.timer.$suggestSolution = "GPTM0";
UART21.uart.$suggestSolution                = "UART1";
UART21.uart.txPin.$suggestSolution          = "boosterpack.4";
UART21.uart.rxPin.$suggestSolution          = "boosterpack.3";
Timer_1.rtc.$suggestSolution                = "RTC0";
